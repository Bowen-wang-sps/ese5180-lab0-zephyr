## l1_e2/tests/SUM_UNIT_TEST/Kconfig
```kconfig
source "Kconfig.zephyr"

choice
    prompt "Sum output method"
    default SUM_PRINT

config SUM_PRINT
    bool "Use printk"

config SUM_LOG
    bool "Use Logger"

endchoice
```
